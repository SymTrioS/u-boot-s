## configs/prime_f1c200s_defconfig
```kconfig
CONFIG_ARM=y
CONFIG_ARCH_SUNXI=y
CONFIG_MACH_SUNIV=y
CONFIG_ENV_SIZE=0x8000
CONFIG_ENV_OFFSET=0xf8000
CONFIG_DEFAULT_DEVICE_TREE="suniv-f1c200s-prime-s"
CONFIG_DRAM_CLK=156
CONFIG_DRAM_ZQ=0
CONFIG_SUNXI_MINIMUM_DRAM_MB=64
CONFIG_VIDEO_SUNXI=y
CONFIG_VIDEO_LCD_MODE="x:800,y:480,depth:18,pclk_khz:33000,le:87,ri:40,up:31,lo:13,hs:1,vs:1,sync:3,vmode:0"
# CONFIG_VIDEO_LOGO=y
CONFIG_CONS_INDEX=2
CONFIG_SPL=y
#CONFIG_CMD_SF=y
CONFIG_ENV_IS_IN_SPI_FLASH=y
CONFIG_SPI=y
CONFIG_SPI_FLASH=y
CONFIG_SPI_FLASH_BAR=y
CONFIG_SPI_FLASH_GIGADEVICE=y
CONFIG_SPI_FLASH_MACRONIX=y
CONFIG_SPI_FLASH_WINBOND=y
CONFIG_SPL_SPI_SUNXI=y
CONFIG_DM_SPI=y
CONFIG_SUN6I_SPI=y

CONFIG_MTD=y
CONFIG_SPI_FLASH_USE_4K_SECTORS=y
CONFIG_SPI_MEM=y
CONFIG_DM_SPI_FLASH=y

CONFIG_CMD_BIND=y
CONFIG_CMD_DM=y
CONFIG_CMD_GPT=y
CONFIG_CMD_MTD=y
CONFIG_CMD_NAND=y
CONFIG_CMD_NAND_TRIMFFS=y
CONFIG_CMD_NAND_LOCK_UNLOCK=y
CONFIG_CMD_NAND_TORTURE=y
CONFIG_CMD_SPI=y
CONFIG_DM_MTD=y
# CONFIG_MTD_RAW_NAND=y
CONFIG_MTD_SPI_NAND=y
```
